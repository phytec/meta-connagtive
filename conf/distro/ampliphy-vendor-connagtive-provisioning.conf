## conf/distro/ampliphy-vendor-connagtive-provisioning.conf
```bitbake
require conf/distro/ampliphy-vendor.conf

DISTRO = "ampliphy-vendor-connagtive-provisioning"
DISTRO_NAME = "ampliPHY Vendor Connagtive Provisioning (Phytec Vendor Distribution + Connagtive IoT Device Suite, used for initial provisioning)"

# The distro feature "connagtive-provisioning" is only used for the initial
# provisioning of a target system in the production stage.
DISTRO_FEATURES += "connagtive-provisioning"

OVERRIDES_append = "${@bb.utils.contains("DISTRO_FEATURES", "connagtive-provisioning", ":connagtive-provisioning", "", d)}"
```

## conf/distro/ampliphy-vendor-connagtive.conf
```bitbake
require conf/distro/ampliphy-vendor-rauc.conf
require conf/distro/common-secure-connagtive.inc

DISTRO = "ampliphy-vendor-connagtive"
DISTRO_NAME = "ampliphy Vendor Connagtive (Phytec Vendor Distribution + Connagtive IoT Device Suite)"
```

## conf/distro/common-secure-connagtive.inc
```bitbake
#add protection shield level
#shieldlow - shieldmedium - shieldhigh
DISTRO_FEATURES += "protectionshield"
PROTECTION_SHIELD_LEVEL = "shieldmedium"
OVERRIDES_append = ":protectionshield:${PROTECTION_SHIELD_LEVEL}"

#password or authenticator for console and sshd
CONNAGTIVE_ROOT_AUTHENTICATION = "password"

# Set phytec-dev-ca version 1.2 as default
PREFERRED_VERSION_phytec-dev-ca = "1.2"
```

## conf/distro/yogurt-vendor-connagtive-provisioning.conf
```bitbake
require conf/distro/yogurt-vendor.conf

DISTRO = "yogurt-vendor-connagtive-provisioning"
DISTRO_NAME = "Yogurt Vendor Connagtive Provisioning (Phytec Vendor Distribution + Connagtive IoT Device Suite, used for initial provisioning)"

# The distro feature "connagtive-provisioning" is only used for the initial
# provisioning of a target system in the production stage.
DISTRO_FEATURES += "connagtive-provisioning"

OVERRIDES_append = "${@bb.utils.contains("DISTRO_FEATURES", "connagtive-provisioning", ":connagtive-provisioning", "", d)}"

# We set the WKS files with the distros. This is not ideal, as it makes the
# distro machine specific. We also cannot allow for setting the WKS file in the
# local.conf after this.
# For the provisioning image we need a simple layout without RAUC that can be
# booted from an SD card.
WKS_FILES_mx8mm = "imx8m-sdimage.wks"
```

## conf/distro/yogurt-vendor-connagtive-wayland.conf
```bitbake
require conf/distro/yogurt-vendor-connagtive.conf

DISTRO = "yogurt-vendor-connagtive-wayland"
DISTRO_NAME = "yogurt Vendor connagtive wayland (Phytec Vendor Distribution)"

DISTRO_FEATURES += "wayland vulkan"
```

## conf/distro/yogurt-vendor-connagtive.conf
```bitbake
require conf/distro/yogurt-vendor.conf

DISTRO = "yogurt-vendor-connagtive"
DISTRO_NAME = "Yogurt Vendor Connagtive (Phytec Vendor Distribution + Connagtive IoT Device Suite)"

#add protection shield level
#shieldlow - shieldmedium - shieldhigh
DISTRO_FEATURES += "protectionshield"
PROTECTION_SHIELD_LEVEL = "shieldmedium"

#password or authenticator for console and sshd
CONNAGTIVE_ROOT_AUTHENTICATION = "password"
```

## conf/layer.conf
```bitbake
# We have a conf and classes directory, add to BBPATH
BBPATH .= ":${LAYERDIR}"

# We have recipes-* directories, add to BBFILES
BBFILES += "${LAYERDIR}/recipes-*/*/*.bb \
            ${LAYERDIR}/recipes-*/*/*.bbappend"

BBFILE_COLLECTIONS += "meta-connagtive"
BBFILE_PATTERN_meta-connagtive = "^${LAYERDIR}/"
BBFILE_PRIORITY_meta-connagtive = "23"

LAYERDEPENDS_meta-connagtive = "phytec openembedded-layer networking-layer meta-python rauc"
LAYERSERIES_COMPAT_meta-connagtive = "zeus"

DISTRO_VERSION_append = "-Connagtive-v1.0"

# Let us add layer-specific bbappends which are only applied when that
# layer is included in our configuration
BBFILES += "${@' '.join('${LAYERDIR}/dynamic-layers/%s/recipes*/*/*.bbappend' % layer \
                for layer in BBFILE_COLLECTIONS.split())}"
BBFILES += "${@' '.join('${LAYERDIR}/dynamic-layers/%s/recipes*/*/*.bb' % layer \
                for layer in BBFILE_COLLECTIONS.split())}"
```

## scripts/lib/wic/canned-wks/imx8mm-connagtive-sdimage.wks
```
part U-BOOT --source rawcopy --sourceparams="file=imx-boot" --ondisk mmc --no-table --align 33

include connagtive-sdimage.wks.in
```

## scripts/lib/wic/canned-wks/imx8mm-esec-iotdm-sdimage.wks
```
part U-BOOT --source rawcopy --sourceparams="file=imx-boot" --ondisk mmc --no-table --align 33

include esec-iotdm-sdimage.wks.in
```
